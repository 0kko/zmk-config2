## config/boards/shields/occokbd/Kconfig.defconfig
```kconfig
if SHIELD_OCCOKBD_LEFT

config ZMK_KEYBOARD_NAME
	default "Occo KBD"

config ZMK_SPLIT_BLE_ROLE_CENTRAL
	default y

CONFIG_ZMK_USB_LOGGING=y

endif

if SHIELD_OCCOKBD_LEFT || SHIELD_OCCOKBD_RIGHT

config ZMK_SPLIT
	default y

endif
```

## config/boards/shields/occokbd/Kconfig.shield
```kconfig
# Copyright (c) 2020 The ZMK Contributors
# SPDX-License-Identifier: MIT

config SHIELD_OCCOKBD_LEFT
	def_bool $(shields_list_contains,occokbd_left)

config SHIELD_OCCCOKBD_RIGHT
	def_bool $(shields_list_contains,occokbd_right)
```
